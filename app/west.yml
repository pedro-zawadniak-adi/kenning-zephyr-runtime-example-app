## app/west.yml
```yaml
# Copyright (c) 2025 Antmicro <www.antmicro.com>
#
# SPDX-License-Identifier: Apache-2.0

manifest:
  remotes:
    - name: zephyrproject-rtos
      url-base: https://github.com/zephyrproject-rtos

    - name: antmicro
      url-base: https://github.com/antmicro

  projects:
    - name: zephyr
      remote: zephyrproject-rtos
      revision: d330e86e033f94c8b0a1a7a3be55c2553713a350
      import:
        path-allowlist:
          - modules/debug/*
          - modules/hal/*
          - modules/lib/*
          - modules/tee/tf-m/*

    - name: kenning-zephyr-runtime
      remote: antmicro
      revision: 79690c0cdf6d08703d2cb4a92e8607457a83937f
      import:
        path-allowlist:
          - dlpack
          - tvm

    # TODO: investigate why adding tflite-micro to above import list does not work
    - name: tflite-micro
      remote: zephyrproject-rtos
      revision: zephyr-v4.1.0
```
